## conf/layer.conf
```bitbake
# We have a conf and classes directory, add to BBPATH
BBPATH .= ":${LAYERDIR}"

# We have recipes-* directories, add to BBFILES
BBFILES += " \
	${LAYERDIR}/recipes/*/*.bb \
	${LAYERDIR}/recipes/*/*.bbappend \
	${LAYERDIR}/recipes-*/*/*.bb \
	${LAYERDIR}/recipes-*/*/*.bbappend \
	"

BBFILE_COLLECTIONS += "luarocks"
BBFILE_PATTERN_luarocks = "^${LAYERDIR}/"
BBFILE_PRIORITY_luarocks = "6"

LAYERDEPENDS_luarocks = "core openembedded-layer"
LAYERSERIES_COMPAT_luarocks = "dunfell hardknott"
```
